## apps/boutique/sure/configs/default_defconfig
```kconfig
CONFIG_PLAT_KVM=y
# CONFIG_KVM_KERNEL_VGA_CONSOLE is not set
# CONFIG_KVM_DEBUG_VGA_CONSOLE is not set
CONFIG_LIBUKBOOT_BANNER_NONE=y
# CONFIG_LIBUKDEBUG_ENABLE_ASSERT is not set
CONFIG_ARCH_X86_64=y
```
